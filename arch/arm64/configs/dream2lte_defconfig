## arch/arm64/configs/dream2lte_defconfig
```kconfig
#
# Modifications for Samsung Galaxy S8+ (dream2lte)
#
CONFIG_MODEL_DREAM2LTE=y
CONFIG_CAMERA_DREAM2=y
CONFIG_POC_DREAM2=y
CONFIG_SENSORS_HRM_ADPD143=y
```

## arch/arm64/configs/dreamlte_defconfig
```kconfig
#
# Modifications for Samsung Galaxy S8 (dreamlte)
#
CONFIG_MODEL_DREAMLTE=y
CONFIG_CAMERA_DREAM=y
CONFIG_POC_DREAM=y
CONFIG_SENSORS_HRM_MAX86902=y
CONFIG_SENSORS_HRM_MAX869_ENHANCED_EOL=y
```
